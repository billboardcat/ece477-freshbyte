# file: ece477-methane-r0-calc.ioc
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Mcu.Family=STM32L0
RCC.MSI_VALUE=2097000
RCC.SYSCLKSource=RCC_SYSCLKSOURCE_PLLCLK
ProjectManager.StackSize=0x400
RCC.HSI48MClockSelection=RCC_USBCLKSOURCE_HSI48
RCC.HSI16_VALUE=16000000
RCC.PLLDIV=RCC_PLLDIV_3
ProjectManager.TargetToolchain=STM32CubeIDE
RCC.HCLKFreq_Value=16000000
RCC.APB2TimFreq_Value=16000000
RCC.LSE_VALUE=32768
RCC.AHBFreq_Value=16000000
RCC.HSE_VALUE=8000000
board=STM32L0538-DISCO
RCC.VCOOutputFreq_Value=48000000
RCC.APB2Freq_Value=16000000
RCC.RTCClockSelectionVirtual=RCC_RTCCLKSOURCE_LSE
PA0.Mode=IN0
Mcu.Name=STM32L053C(6-8)Tx
PA0.Signal=ADC_IN0
RCC.SYSCLKFreq_VALUE=16000000
Mcu.Package=LQFP48
ProjectManager.HeapSize=0x200
RCC.HSI_VALUE=16000000
RCC.APB1TimFreq_Value=16000000
RCC.APB1Freq_Value=16000000
RCC.HSI48_VALUE=48000000

// file: Core/Src/main.c
/* USER CODE BEGIN Header */
/**
  ******************************************************************************
  * @file           : main.c
  * @brief          : Main program body
  ******************************************************************************
  * @attention
  *
  * <h2><center>&copy; Copyright (c) 2021 STMicroelectronics.
  * All rights reserved.</center></h2>
  *
  * This software component is licensed by ST under BSD 3-Clause license,
  * the "License"; You may not use this file except in compliance with the
  * License. You may obtain a copy of the License at:
  *                        opensource.org/licenses/BSD-3-Clause
  *
  ******************************************************************************
  */
/* USER CODE END Header */
#include "main.h"
#include "adc.h"
#include "gpio.h"
#include "math.h"

void SystemClock_Config(void);

int main(void)
{

  /* MCU Configuration--------------------------------------------------------*/

  /* Reset of all peripherals, Initializes the Flash interface and the Systick. */
  HAL_Init();

  /* Configure the system clock */
  SystemClock_Config();

  /* Initialize all configured peripherals */
  MX_GPIO_Init();
  MX_ADC_Init();

  /* Infinite loop */
  /* USER CODE BEGIN WHILE */
  // code source: https://thestempedia.com/tutorials/interfacing-mq-4-gas-sensor-evive/
  uint16_t methane = 0;
  float average;
  float voltage;
  float rs_air;
  float r0;
  float ratio;
  float m = -0.318;
  float b = 1.133;

  HAL_ADC_Start(&hadc);
  for(int i = 0; i < 500; i++)
  {
	  HAL_ADC_PollForConversion(&hadc, HAL_MAX_DELAY);
	  methane += HAL_ADC_GetValue(&hadc);
    /* USER CODE END WHILE */
    /* USER CODE BEGIN 3 */
  }
  HAL_ADC_Stop(&hadc);

  average = methane / 500.0;
  voltage = average * (5.0 / 1023.0);
  rs_air = ((5.0 * 10.0) / voltage) - 10.0;
  r0 = rs_air / 4.4;

  HAL_ADC_Start(&hadc);
  HAL_ADC_PollForConversion(&hadc, HAL_MAX_DELAY);
  methane = HAL_ADC_GetValue(&hadc);    //Read analog values of sensor
  HAL_ADC_Stop(&hadc);

  voltage = methane * (5.0 / 1023.0);       //Convert analog values to voltage
  rs_gas = ((5.0 * 10.0) / voltage) - 10.0;      //Get value of RS in a gas
  ratio = rs_gas / r0;                          // Get ratio RS_gas/RS_air

  double ppm_log = (log10(ratio) - b) / m;     //Get ppm value in linear scale according to the the ratio value
  double ppm = pow(10, ppm_log);
  printf("ppm: %d", (int)ppm);

  /* USER CODE END 3 */
}

void SystemClock_Config(void)
{
  RCC_OscInitTypeDef RCC_OscInitStruct = {0};
  RCC_ClkInitTypeDef RCC_ClkInitStruct = {0};

  /** Configure the main internal regulator output voltage
  */
  __HAL_PWR_VOLTAGESCALING_CONFIG(PWR_REGULATOR_VOLTAGE_SCALE1);
  /** Initializes the RCC Oscillators according to the specified parameters
  * in the RCC_OscInitTypeDef structure.
  */
  RCC_OscInitStruct.OscillatorType = RCC_OSCILLATORTYPE_HSI;
  RCC_OscInitStruct.HSIState = RCC_HSI_ON;
  RCC_OscInitStruct.HSICalibrationValue = RCC_HSICALIBRATION_DEFAULT;
  RCC_OscInitStruct.PLL.PLLState = RCC_PLL_ON;
  RCC_OscInitStruct.PLL.PLLSource = RCC_PLLSOURCE_HSI;
  RCC_OscInitStruct.PLL.PLLMUL = RCC_PLLMUL_3;
  RCC_OscInitStruct.PLL.PLLDIV = RCC_PLLDIV_3;
  if (HAL_RCC_OscConfig(&RCC_OscInitStruct) != HAL_OK)
  {
    Error_Handler();
  }
  /** Initializes the CPU, AHB and APB buses clocks
  */
  RCC_ClkInitStruct.ClockType = RCC_CLOCKTYPE_HCLK|RCC_CLOCKTYPE_SYSCLK
                              |RCC_CLOCKTYPE_PCLK1|RCC_CLOCKTYPE_PCLK2;
  RCC_ClkInitStruct.SYSCLKSource = RCC_SYSCLKSOURCE_PLLCLK;
  RCC_ClkInitStruct.AHBCLKDivider = RCC_SYSCLK_DIV1;
  RCC_ClkInitStruct.APB1CLKDivider = RCC_HCLK_DIV1;
  RCC_ClkInitStruct.APB2CLKDivider = RCC_HCLK_DIV1;

  if (HAL_RCC_ClockConfig(&RCC_ClkInitStruct, FLASH_LATENCY_0) != HAL_OK)
  {
    Error_Handler();
  }
}

void Error_Handler(void)
{
  __disable_irq();
  while (1)
  {
  }
}

/************************ (C) COPYRIGHT STMicroelectronics *****END OF FILE****/
